## conf/distro/dealcore-framebuffer.conf
```bitbake
require conf/distro/include/dealcore-base.inc

DISTRO = "dealcore-framebuffer"
DISTRO_NAME = "DealCore FB Backend"
```

## conf/distro/dealcore-openwrt.conf
```bitbake
require conf/distro/include/dealcore-base.inc

DISTRO = "dealcore-openwrt"
DISTRO_NAME = "DealCore OpenWrt"

DISTRO_FEATURES_remove = "opengl egl"

DISTRO_FEATURES_append = " procd"

VIRTUAL-RUNTIME_dev_manager = "procd"
VIRTUAL-RUNTIME_login_manager = "busybox"
VIRTUAL-RUNTIME_init_manager = "procd"
VIRTUAL-RUNTIME_kmod_manager = "ubox"
VIRTUAL-RUNTIME_syslog = "ubox"
VIRTUAL-RUNTIME_base-utils = "busybox"
VIRTUAL-RUNTIME_network_manager = "netifd"

MACHINE_FEATURES_remove = "display"

DUMMY_DEFCONFIG = "dummy_defconfig"
MPU_V2_ROUTER_DEFCONFIG = "${@bb.utils.contains('MACHINE', 'mpu-v2', 'mpu-v2-router_defconfig', '${DUMMY_DEFCONFIG}', d)}"
ROUTER_DEFCONFIG = "${@bb.utils.contains('MACHINE', 'drmc', 'drmc-router_defconfig', '${MPU_V2_ROUTER_DEFCONFIG}', d)}"
KBUILD_DEFCONFIG = "${ROUTER_DEFCONFIG}"

DUMMY_DEVICETREE = "rockchip/dummy.dtb"
MPU_V2_ROUTER_DEVICETREE = "${@bb.utils.contains('MACHINE', 'mpu-v2', 'rockchip/mpu-v2-router.dtb', '${DUMMY_DEFCONFIG}', d)}"
ROUTER_DEVICETREE = "${@bb.utils.contains('MACHINE', 'drmc', 'rockchip/drmc-router.dtb', '${MPU_V2_ROUTER_DEVICETREE}', d)}"
KERNEL_DEVICETREE = "${ROUTER_DEVICETREE}"

# PREFERRED_VERSION_rockchip-linux = "4.19%"
# LINUXLIBCVERSION = "rockchip-linux-4.19%"
```

## conf/distro/dealcore-wayland.conf
```bitbake
require conf/distro/include/dealcore-base.inc

DISTRO = "dealcore-wayland"
DISTRO_NAME = "DealCore Wayland Backend"

# These are wayland specific
DISTRO_FEATURES_append = " wayland gl vulkan"
```

## conf/distro/dealcore-x11.conf
```bitbake
require conf/distro/include/dealcore-base.inc

DISTRO = "dealcore-x11"
DISTRO_NAME = "DealCore X11 Backend"

# These are X11 specific
DISTRO_FEATURES_append = " x11 gl vulkan"

XSERVER = " \
        xserver-xorg xf86-video-fbdev \
        xserver-xorg-extension-glx \
        xf86-video-modesetting \
"
```

## conf/distro/dealcore-xwayland.conf
```bitbake
require conf/distro/include/dealcore-base.inc

DISTRO = "dealcore-xwayland"
DISTRO_NAME = "DealCore X11 Wayland Backend"

DISTRO_FEATURES_append = " x11 wayland"
```

## conf/distro/include/dealcore-base.inc
```bitbake
require conf/distro/poky.conf

DISTRO = "dealcore-base"
DISTRO_NAME = "DealCore Base"
SDK_VENDOR = "-dealcoresdk"

MAINTAINER = "Ponmadasamy Muthuraj<ponmadasamy@live.com>"

TARGET_VENDOR = "-duragon"

DISTRO_FEATURES_append = " systemd egl"
DISTRO_FEATURES_remove = "pcmcia sysvint gl multiarch x11 wayland nfc usbgadget vulkan"
DISTRO_FEATURES_BACKFILL_CONSIDERED_append = " sysvinit systemd x11 wayland"
VIRTUAL-RUNTIME_init_manager = " systemd"
```

## conf/layer.conf
```bitbake
# We have a conf and classes directory, add to BBPATH
BBPATH .= ":${LAYERDIR}"

# We have recipes-* directories, add to BBFILES
BBFILES += "${LAYERDIR}/recipes-*/*/*.bb \
            ${LAYERDIR}/recipes-*/*/*.bbappend"

BBFILES_DYNAMIC += " \
	qt5-layer:${LAYERDIR}/recipes-dynamic/recipes-qt/*/*.bbappend \
    qt5-layer:${LAYERDIR}/recipes-dynamic/recipes-core/meta/dealcore-sdk-qt5.bb \
    qt5-layer:${LAYERDIR}/recipes-dynamic/recipes-core/images/dealcore-gui-qt5.bb \
    xfce-layer:${LAYERDIR}/recipes-dynamic/recipes-core/images/dealcore-xfce.bb \
    openwrt-layer:${LAYERDIR}/recipes-dynamic/recipes-core/netifd/netifd_git.bbappend \
    openwrt-layer:${LAYERDIR}/recipes-dynamic/recipes-core/images/dealcore-openwrt.bb \
    openwrt-layer:${LAYERDIR}/recipes-dynamic/recipes-core/images/dealcore-openwrt-qt5.bb \
    openwrt-layer:${LAYERDIR}/recipes-dynamic/recipes-core/xtables-addons/xtables-addons_3.13.bbappend \
    openwrt-layer:${LAYERDIR}/recipes-dynamic/recipes-extended/mountd/mountd_git.bbappend \
    perl-layer:${LAYERDIR}/recipes-dynamic/recipes-perl/*/*.bbappend \
    perl-layer:${LAYERDIR}/recipes-dynamic/recipes-perl/*/*.bb \
    webserver:${LAYERDIR}/recipes-dynamic/recipes-httpd/*/*.bbappend \
    webserver:${LAYERDIR}/recipes-dynamic/recipes-httpd/*/*.bb \
"

BBFILE_COLLECTIONS += "dealcore"
BBFILE_PATTERN_dealcore = "^${LAYERDIR}/"
BBFILE_PRIORITY_dealcore = "6"

DEALCOREBASE = '${@os.path.normpath("${LAYERDIR}")}'
BB_HASHBASE_WHITELIST_append += " DEALCOREBASE"

LAYERDEPENDS_dealcore = "core"
LAYERSERIES_COMPAT_dealcore = "dunfell"

LICENSE_PATH += "${LAYERDIR}/licenses"

DEALCORE_GIT = "git://github.com/ponmadasamy"
```

## conf/machine/common.conf
```bitbake
#For Audio
IMAGE_INSTALL_append += " alsa-utils rockchip-alsa-config pulseaudio-server alsa-plugins-pulseaudio-conf"
#For Internet Browser
IMAGE_INSTALL_append += " ${@bb.utils.contains('DISTRO_FEATURES', 'wayland', 'chromium-ozone-wayland libv4l v4l-rkmpp', '', d)}"
IMAGE_INSTALL_append += " ${@bb.utils.contains('DISTRO_FEATURES', 'x11', 'chromium-x11 libv4l v4l-rkmpp', '', d)}"
# For debug
IMAGE_INSTALL_append += " libdrm-tests strace gdb e2fsprogs e2fsprogs-resize2fs io perf openssh-sftp-server"
IMAGE_FEATURES += "ssh-server-openssh"
# For adb
IMAGE_INSTALL_append += " android-tools"
# For glmark2
DISTRO_FEATURES_append += " opengl"
IMAGE_INSTALL_append += " glmark2"
```

## conf/machine/include/friendlyarm-rk3399-som-v2.inc
```bitbake
require rk3399.inc 
require rk3399_image.inc

MACHINE = "friendlyarm-rk3399-som-v2"

RK_WIFIBT_FIRMWARES = " \
	rkwifibt-firmware-ap6356-wifi \
	rkwifibt-firmware-ap6356-bt \
	rkwifi-init \
"

MACHINE_EXTRA_RRECOMMENDS_append = " \
	${RK_WIFIBT_FIRMWARES} \
	kernel-modules \
"
#	linux-firmware-rk-cdndp

# For Wireless
IMAGE_INSTALL_append = " \
	iw wpa-supplicant bluez5 \
	${MACHINE_EXTRA_RRECOMMENDS} \
"

PREFERRED_PROVIDER_virtual/xserver = "xserver-xorg"
PREFERRED_PROVIDER_virtual/xserver-xf86 = "xserver-xorg"

# PREFERRED_PROVIDER_virtual/xserver = "rockchip-xserver-xorg"
# PREFERRED_PROVIDER_virtual/xserver-xf86 = "rockchip-xserver-xorg"
# PREFERRED_VERSION_rockchip-xserver-xorg = "1.20.4"

# ROCKCHIP-XSERVER-XORG = " \
#	rockchip-xserver-xorg-extension-dri \
#	rockchip-xserver-xorg-extension-dri2 \
#	rockchip-xserver-xorg-extension-glx \
# "

# XSERVER = " \
#		rockchip-xserver-xorg \
#		xf86-input-libinput \
#		${ROCKCHIP-XSERVER-XORG} \
# "

# PACKAGECONFIG_append_pn-rockchip-xserver = " "
```

## conf/machine/include/friendlyarm-som-rk3399.inc
```bitbake
require rk3399.inc 
require rk3399_image.inc

MACHINE = "friendlyarm-som-rk3399"

KERNEL_DEVICETREE = "rockchip/friendlyarm-rk3399-som.dtb"
KBUILD_DEFCONFIG = "friendlyarm-rk3399-som_defconfig"

UBOOT_MACHINE = "friendlyarm-rk3399-som_defconfig"

MACHINE_EXTRA_RRECOMMENDS_append = " \
	rkwifibt-firmware-ap6356-wifi rkwifibt-firmware-ap6356-bt rkwifibt-init brcm-tools \
	iw wpa-supplicant bluez5 \
	kernel-modules \
	alsa-utils rockchip-alsa-config pulseaudio-server alsa-plugins-pulseaudio-conf \
"

PREFERRED_PROVIDER_virtual/xserver = "xserver-xorg"
PREFERRED_PROVIDER_virtual/xserver-xf86 = "xserver-xorg"
```

## conf/machine/include/rk3399.inc
```bitbake
# Copyright (c) 2019, Fuzhou Rockchip Electronics Co., Ltd
# Released under the MIT license (see COPYING.MIT for the terms)

require conf/machine/include/soc-family.inc
include conf/machine/include/arm/arch-armv8a.inc

SOC_FAMILY = "rk3399"
DEFAULTTUNE_rk3399 = "aarch64"

MACHINE_FEATURES_remove = "qemu-usermode"
MACHINE_FEATURES_BACKFILL_CONSIDERED_append = "qemu-usermode"

MALI_GPU := "midgard-t86x"
MALI_VERSION := "r18p0"

RK_ISP_VERSION := "1"

SERIAL_CONSOLES = "1500000;ttyFIQ0"
KERNEL_IMAGETYPE ?= "Image"
MACHINEOVERRIDES .= ":rockchip"

PREFERRED_PROVIDER_virtual/kernel = "rockchip-linux"
PREFERRED_VERSION_rockchip-linux = "4.4%"
LINUXLIBCVERSION = "rockchip-linux-4.4%"

RK_USE_COMPRESSED_KERNEL = "0"

PREFERRED_PROVIDER_virtual/bootloader = "rockchip-uboot"
PREFERRED_VERSION_rockchip-uboot = "2017.09"

# Custom kernel might not support newest python
PACKAGECONFIG_remove_pn-perf += " scripting"

PREFERRED_PROVIDER_virtual/libgl = "mesa-gl"
PREFERRED_PROVIDER_virtual/mesa = "mesa-gl"
PREFERRED_PROVIDER_virtual/egl = "rockchip-libmali"
PREFERRED_PROVIDER_virtual/libgles1 = "rockchip-libmali"
PREFERRED_PROVIDER_virtual/libgles2 = "rockchip-libmali"
PREFERRED_PROVIDER_virtual/libgles3 = "rockchip-libmali"
PREFERRED_PROVIDER_virtual/libopencl = "rockchip-libmali"
PREFERRED_PROVIDER_virtual/libgbm = "rockchip-libmali"

DEPENDS_append_pn-mesa-gl += " rockchip-libmali"

PREFERRED_RPROVIDER_lib32-initd-functions = "lib32-initscripts"

# Workaround: libmali.so provided by rk having no SONAME field in it
# so add it to fix rdepends problems
ASSUME_SHLIBS += "libEGL.so:rockchip-libmali"
ASSUME_SHLIBS += "libGLESv1_CM.so:rockchip-libmali"
ASSUME_SHLIBS += "libGLESv2.so:rockchip-libmali"
ASSUME_SHLIBS += "libOpenCL.so:rockchip-libmali"
ASSUME_SHLIBS += "libgbm.so:rockchip-libmali"
ASSUME_SHLIBS += "libwayland-egl.so:rockchip-libmali"
```

## conf/machine/include/rk3399_image.inc
```bitbake
export RK_ROOTDEV_UUID ?= "614e0000-0000-4b53-8000-1d28000054a9"
export RK_PARTITION_GROW ?= "1"

RDEPENDS_${KERNEL_PACKAGE_NAME}-base = ""

IMAGE_FSTYPES_remove += "iso live"
export RK_ROOTFS_TYPE ?= "ext4"

IMAGE_FSTYPES += "${RK_ROOTFS_TYPE} wic"
WKS_FILES = "sdmmc-gptdisk.wks.in"

# Some partitons, e.g. trust, are allowed to be optional.
do_fixup_wks[depends] += " \
	virtual/kernel:do_deploy \
	virtual/bootloader:do_deploy \
"
do_fixup_wks() {
	if [ ! -f "${WKS_FULL_PATH}" ];then
		bbwarn "${WKS_FULL_PATH} missing"
	fi

	IMAGES=$(grep -o "[^=]*\.img" "${WKS_FULL_PATH}")

	for image in ${IMAGES};do
		if [ ! -f "${DEPLOY_DIR_IMAGE}/${image}" ];then
			echo "${image} not provided, ignoring it."
			sed -i "/file=${image}/d" "${WKS_FULL_PATH}"
		fi
	done
}
addtask do_fixup_wks after do_write_wks_template before do_image_wic

IMAGE_POSTPROCESS_COMMAND += "link_rootfs_image;"
link_rootfs_image() {
	ln -sf "${IMAGE_LINK_NAME}.${RK_ROOTFS_TYPE}" \
		"${IMGDEPLOYDIR}/rootfs.img"
}

IMAGE_POSTPROCESS_COMMAND += "gen_rkparameter;"
gen_rkparameter() {
	if [ ! -f "${DEPLOY_DIR_IMAGE}/loader.bin" ];then
		echo "Skip making Rockchip parameter."
		return
	fi

	IMAGE="${IMGDEPLOYDIR}/${IMAGE_LINK_NAME}.wic"
	if [ ! -f "${IMAGE}" ];then
		echo "${IMAGE} not found."
		return
	fi

	cd "${IMGDEPLOYDIR}"

	OUT="${IMAGE_LINK_NAME}.parameter"
	ln -sf "${OUT}" parameter

	echo "Generating ${OUT}..."

	echo "# IMAGE_NAME: $(readlink ${IMAGE})" > "${OUT}"
	echo "FIRMWARE_VER: 1.0" >> "${OUT}"
	echo "TYPE: GPT" >> "${OUT}"
	echo -n "CMDLINE: mtdparts=rk29xxnand:" >> "${OUT}"
	sgdisk -p "${IMAGE}" | grep -E "^ +[0-9]" | while read line;do
		NAME=$(echo ${line} | cut -f 7 -d ' ')
		START=$(echo ${line} | cut -f 2 -d ' ')
		END=$(echo ${line} | cut -f 3 -d ' ')
		SIZE=$(expr ${END} - ${START} + 1)
		printf "0x%08x@0x%08x(%s)," ${SIZE} ${START} ${NAME} >> "${OUT}"
	done
	echo >> "${OUT}"

	if [ "$RK_PARTITION_GROW" = "1" ];then
		sed -i "s/[^,]*\(@[^,]*\)),$/-\1:grow)/" "${OUT}"
	fi

	echo "uuid: rootfs=${RK_ROOTDEV_UUID}" >> "${OUT}"
}

IMAGE_POSTPROCESS_COMMAND += "gen_rkupdateimg;"
do_image[depends] += "rk-binary-native:do_populate_sysroot"
gen_rkupdateimg() {
	if [ ! -f "${DEPLOY_DIR_IMAGE}/loader.bin" ];then
		echo "Skip packing Rockchip update image."
		return
	fi

	IMAGE="${IMGDEPLOYDIR}/${IMAGE_LINK_NAME}.wic"
	if [ ! -f "${IMAGE}" ];then
		echo "${IMAGE} not found."
		return
	fi

	cd "${IMGDEPLOYDIR}"

	RK_IMAGES="loader.bin uboot.env uboot.img trust.img kernel.img \
			resource.img boot.img"

	RK_IMAGES="loader.bin idbloader.img u-boot.itb boot.img rootfs.img"
	# Create temporary symlinks, because the tool would crash with abs pathes
	for img in ${RK_IMAGES};do
		f="${DEPLOY_DIR_IMAGE}/${img}"
		[ -f "${f}" ] && ln -sf "${f}" "./${img}"
	done

	OUT="${IMAGE_LINK_NAME}.package-file"
	ln -sf "${OUT}" package-file
	
	echo "Generating ${OUT}..."

	echo "# IMAGE_NAME: $(readlink ${IMAGE})" > "${OUT}"
	echo "package-file package-file" >> "${OUT}"
	echo "bootloader idbloader.img" >> "${OUT}"
	echo "parameter parameter" >> "${OUT}"
	echo "loader2 u-boot.itb" >> "${OUT}"
	echo "boot boot.img" >> "${OUT}"
	echo "rootfs rootfs.img" >> "${OUT}"
	
	afptool -pack ./ update.raw.img
	rkImageMaker -RK$(hexdump -s 21 -n 4 -e '4/1 "%c"' loader.bin | rev) \
		loader.bin update.raw.img "${IMAGE_LINK_NAME}.update.img" \
		-os_type:androidos
	ln -sf "${IMAGE_LINK_NAME}.update.img" update.img

	rm -rf ${RK_IMAGES} update.raw.img
}

IMAGE_POSTPROCESS_COMMAND += "link_latest_image;"
link_latest_image() {
	rm -rf "${TOPDIR}/latest"
	ln -sf "${DEPLOY_DIR_IMAGE}" "${TOPDIR}/latest"
}
```

## conf/machine/mpu-v2.conf
```bitbake
require include/friendlyarm-som-rk3399.inc

MAINTAINER = "Ponmadasamy Muthuraj <ponmadasamy@live.com>"

MACHINE = "mpu-v2"
MACHINE_FEATURES_append = " display"

KERNEL_DEVICETREE = "rockchip/mpu-v2.dtb"
KBUILD_DEFCONFIG = "mpu-v2_defconfig"
UBOOT_MACHINE = "mpu-v2_defconfig"

LICENSE_FLAGS_WHITELIST = " commercial"
GSTREAMER = " \
	gstreamer1.0 \
	gstreamer1.0-plugins-base gstreamer1.0-plugins-good gstreamer1.0-plugins-bad gstreamer1.0-plugins-ugly \
	gstreamer1.0-rockchip \
"

MACHINE_EXTRA_RRECOMMENDS_append = " \
	${GSTREAMER} \
"
```

## conf/machine/mpu.conf
```bitbake
require include/friendlyarm-rk3399-som-v2.inc

MAINTAINER = "Ponmadasamy Muthuraj <ponmadasamy@live.com>"

MACHINE = "mpu"

KERNEL_DEVICETREE = "rockchip/mpu-v2.dtb"
KBUILD_DEFCONFIG = "mpu-v2_defconfig"
UBOOT_MACHINE = "mpu-v2_defconfig"

# For glmark2
DISTRO_FEATURES_append = " opengl"
# For mali gpu
DISTRO_FEATURES_append += " egl"

AUDIO = " \
	alsa-utils rockchip-alsa-config pulseaudio-server alsa-plugins-pulseaudio-conf \
"

LICENSE_FLAGS_WHITELIST = " commercial"
GSTREAMER = " \
	gstreamer1.0 \
	gstreamer1.0-plugins-base gstreamer1.0-plugins-good gstreamer1.0-plugins-bad gstreamer1.0-plugins-ugly \
	gstreamer1.0-rockchip \
"

IMAGE_INSTALL_append = " \
	${AUDIO} \
	${GSTREAMER} \
"
```
